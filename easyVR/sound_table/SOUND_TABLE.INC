; external declaration of sound table:

    .EXTRN (const) SNDTBL_SOUND_TABLE



; external declarations of addresses of sounds for direct access:

    .EXTRN (const) SX_apples
    .EXTRN (const) SX_automatic_mode
    .EXTRN (const) SX_bacon
    .EXTRN (const) SX_beans
    .EXTRN (const) SX_bread
    .EXTRN (const) SX_candy
    .EXTRN (const) SX_champagne
    .EXTRN (const) SX_close
    .EXTRN (const) SX_closet1_shelf1
    .EXTRN (const) SX_closet1_shelf2
    .EXTRN (const) SX_closet2_shelf1
    .EXTRN (const) SX_closet2_shelf2
    .EXTRN (const) SX_coke
    .EXTRN (const) SX_cookies
    .EXTRN (const) SX_croissant
    .EXTRN (const) SX_eggs
    .EXTRN (const) SX_foie_gras
    .EXTRN (const) SX_gin
    .EXTRN (const) SX_good_bye
    .EXTRN (const) SX_happy_mood
    .EXTRN (const) SX_ketchup
    .EXTRN (const) SX_manual_mode
    .EXTRN (const) SX_milk
    .EXTRN (const) SX_ok_mood
    .EXTRN (const) SX_open
    .EXTRN (const) SX_open_mode
    .EXTRN (const) SX_pasta
    .EXTRN (const) SX_pate
    .EXTRN (const) SX_pepper
    .EXTRN (const) SX_repeat_command
    .EXTRN (const) SX_sad_mood
    .EXTRN (const) SX_salt
    .EXTRN (const) SX_soda
    .EXTRN (const) SX_spaghetti
    .EXTRN (const) SX_sugar
    .EXTRN (const) SX_tomatos
    .EXTRN (const) SX_water
    .EXTRN (const) SX_welcome
    .EXTRN (const) SX_wine


; equates defining sounds as entries in the sound table:

SND_apples              .EQU 1
SND_automatic_mode      .EQU 2
SND_bacon               .EQU 3
SND_beans               .EQU 4
SND_bread               .EQU 5
SND_candy               .EQU 6
SND_champagne           .EQU 7
SND_close               .EQU 8
SND_closet1_shelf1      .EQU 9
SND_closet1_shelf2      .EQU 10
SND_closet2_shelf1      .EQU 11
SND_closet2_shelf2      .EQU 12
SND_coke                .EQU 13
SND_cookies             .EQU 14
SND_croissant           .EQU 15
SND_eggs                .EQU 16
SND_foie_gras           .EQU 17
SND_gin                 .EQU 18
SND_good_bye            .EQU 19
SND_happy_mood          .EQU 20
SND_ketchup             .EQU 21
SND_manual_mode         .EQU 22
SND_milk                .EQU 23
SND_ok_mood             .EQU 24
SND_open                .EQU 25
SND_open_mode           .EQU 26
SND_pasta               .EQU 27
SND_pate                .EQU 28
SND_pepper              .EQU 29
SND_repeat_command      .EQU 30
SND_sad_mood            .EQU 31
SND_salt                .EQU 32
SND_soda                .EQU 33
SND_spaghetti           .EQU 34
SND_sugar               .EQU 35
SND_tomatos             .EQU 36
SND_water               .EQU 37
SND_welcome             .EQU 38
SND_wine                .EQU 39

